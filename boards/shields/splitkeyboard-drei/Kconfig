## boards/shields/splitkeyboard-drei/Kconfig
```kconfig
if SPLITKEYBOARD_DREI_LEFT || SPLITKEYBOARD_DREI_RIGHT

config ZMK_KEYBOARD_NAME
    default "SplitKeyboard Drei"

config ZMK_SPLIT_ROLE_CENTRAL
    default y if SPLITKEYBOARD_DREI_LEFT

config ZMK_SPLIT_ROLE_PERIPHERAL
    default y if SPLITKEYBOARD_DREI_RIGHT

endif
```

## boards/shields/splitkeyboard-drei/Kconfig.defconfig
```kconfig
if SPLITKEYBOARD_DREI_LEFT

config ZMK_KEYBOARD_NAME
    default "SplitKeyboard Drei"

config ZMK_SPLIT_ROLE_CENTRAL
    default y

endif

if SPLITKEYBOARD_DREI_LEFT || SPLITKEYBOARD_DREI_RIGHT

config ZMK_SPLIT
    default y

endif
```

## boards/shields/splitkeyboard-drei/Kconfig.shield
```kconfig
config SPLITKEYBOARD_DREI_LEFT
    def_bool $(shields_list_contains,splitkeyboard_drei_left)

config SPLITKEYBOARD_DREI_RIGHT
    def_bool $(shields_list_contains,splitkeyboard_drei_right)
```

## boards/shields/splitkeyboard_drei/Kconfig.defconfig
```kconfig
if SHIELD_SPLITKEYBOARD_DREI_LEFT

config ZMK_KEYBOARD_NAME
    default "SplitKB Drei"

config ZMK_SPLIT_ROLE_CENTRAL
    default y

endif

if SHIELD_SPLITKEYBOARD_DREI_LEFT || SHIELD_SPLITKEYBOARD_DREI_RIGHT

config ZMK_SPLIT
    default y

endif
```

## boards/shields/splitkeyboard_drei/Kconfig.shield
```kconfig
config SHIELD_SPLITKEYBOARD_DREI_LEFT
    def_bool $(shields_list_contains,splitkeyboard_drei_left)

config SHIELD_SPLITKEYBOARD_DREI_RIGHT
    def_bool $(shields_list_contains,splitkeyboard_drei_right)
```
